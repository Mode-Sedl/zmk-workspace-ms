## config/west.yml
```yaml
manifest:
  defaults:
    remote: zmkfirmware
  remotes:
    - name: zmkfirmware
      url-base: https://github.com/zmkfirmware
    - name: urob
      url-base: https://github.com/urob
    # Additional modules containing boards/shields/custom code can be listed here as well
    # See https://docs.zephyrproject.org/3.2.0/develop/west/manifest.html#projects
  projects:
    - name: zmk
      revision: 641514a97db345f499dd50b0360e594270f008fe # main (2026-08-31)
      import: app/west.yml
    # ZMK modules
    - name: zmk-helpers
      remote: urob
      path: modules/zmk/helpers
      revision: 95edb8f15ef1d1bd8332810555f8cf5837fbdd27 # main (2026-08-31)
    - name: zmk-leader-key
      remote: urob
      path: modules/zmk/leader-key
      revision: e894d9afa5164b7fff641db4194fc3d4d6e84bbb # main (2026-08-18)
    - name: zmk-unicode
      remote: urob
      path: modules/zmk/unicode
      revision: 5f458b6f1fd8ca83f4aba793c2a64916522507e9 # main (2026-08-31)
  self:
    path: config
```
